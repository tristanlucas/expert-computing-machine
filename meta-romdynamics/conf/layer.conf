## meta-romdynamics/conf/layer.conf
```bitbake
# We have a conf and classes directory, add to BBPATH
BBPATH .= ":${LAYERDIR}"

# We have recipes-* directories, add to BBFILES
BBFILES += "${LAYERDIR}/recipes-*/*/*.bb \
            ${LAYERDIR}/recipes-*/*/*.bbappend"

BBFILE_COLLECTIONS += "meta-romdyanmics"
BBFILE_PATTERN_meta-romdyanmics = "^${LAYERDIR}/"
BBFILE_PRIORITY_meta-romdyanmics = "6"

LAYERDEPENDS_meta-romdyanmics = "core"
LAYERSERIES_COMPAT_meta-romdyanmics = "nanbield"
```
